## KConfig
```kconfig
#
# Top level configuration for Legato.
#
# Copyright (C) Sierra Wireless Inc.
#

mainmenu "Legato Configuration"

rsource "legato.kconfig"

menu "Framework Adaptor"
depends on CUSTOM_FA
orsource "$(LE_CONFIG_CUSTOM_FA_PATH)/KConfig"
endmenu # end "Legato Framework Adaptor"
```

## apps/platformServices/KConfig
```kconfig
#
# Configuration for Legato services.
#
# Copyright (C) Sierra Wireless Inc.
#

### Hidden Options ###

config AVC_ENABLE_AV_MODEL
  bool
  depends on !TARGET_VIRT_X86 && !TARGET_VIRT_ARM
  depends on !TARGET_LOCALHOST
  depends on !TARGET_RASPI
  default n if TARGET_CUSTOM
  default y

### General Options (applies to all services) ###

config SERVICES_WATCHDOG
  bool "Enable watchdog for Legato services"
  default y
  ---help---
  The services watchdog ensures that Legato processes are restarted if they
  deadlock.

### Service Options ###

menu "AirVantage Connector"

choice
  prompt "AirVantage Connector application"
  default APP_AVC_LEGACY if TARGET_AR7 || TARGET_AR86
  default APP_AVC_LWM2MCORE

config APP_AVC_LEGACY
  bool "legacy"
  ---help---
  Legacy AVC implementation.  Not for new devices.

config APP_AVC_LWM2MCORE
  bool "lwm2mcore"
  ---help---
  AVC implementation based on LWM2MCore.

endchoice # end "AirVantage Connector application"

config AVC_FEATURE_OBSERVE
  bool "Enable LWM2M observe"
  default y if TARGET_WP85
  default y if TARGET_WP750X
  default y if TARGET_WP76XX
  default y if TARGET_WP77XX
  default n
  ---help---
  Enable LWM2M observe.

# TODO: better description

config AVC_FEATURE_AVMS_CONFIG
  bool "Enable AVMS configuration"
  default y if TARGET_WP85
  default y if TARGET_WP750X
  default y if TARGET_WP76XX
  default y if TARGET_WP77XX
  default n
  ---help---
  Enable AVMS configuration.

# TODO: better description

config ENABLE_AV_DATA
  bool "Enable AV Data"
  default n if RTOS
  default y
  ---help---
  Select this to enable support for AV Data features.

config SOTA
  bool "Enable software-over-the-air (SOTA) updates"
  depends on POSIX
  depends on ENABLE_AV_DATA
  default y
  ---help---
  Select this to enable support for SOTA updates.  SOTA is not supported on
  non-POSIX systems.

config ENABLE_AV_SMS_COUNT
  bool "Enable AV SMS counting support for LWM2M resources lwm2m.7.0.x"
  default n if RTOS
  default y
  ---help---
  When checked, SMS monitoring/counting is enabled and LWM2M resources
  lwm2m.7.0.x return valid statistic values related to SMS counting.

config AVC_HTTP_TIMEOUT_MS
  int "AVC HTTP connection timeout (msec)"
  default 30000
  ---help---
  The timeout (msec) of the HTTP connection used to download the package.

config AVC_FEATURE_EDM
  bool "Enable Extended Device Management (EDM)"
  default n
  ---help---
  Enable SIM Reachability / Extended Device Management (EDM)

endmenu # end "AirVantage Connector"

menu "AT Service"

config ATSERVER_DEVICE_POOL_SIZE
  int "Define the maximal number of AT server devices"
  default 2

config ATSERVER_USER_ERRORS
  bool "Enable user-defined AT errors"
  default y if LINUX
  default n
  ---help---
  Allow setting user-defined error strings in AT server.  Enabling this
  increases the memory consumption of the AT server.

config ATSERVER_TEXT_API
  bool "Enable text API"
  default y if POSIX
  default n
  ---help---
    Allow use of text API.

endmenu

menu "Port Service"
  visible if HAS_PORT_CONFIG_FILE_CONFIGURABLE

config PORT_CONFIG_IS_STATIC
  bool "The ports configuration is static"
  default y if CUSTOM_OS
  default n if LINUX
  ---help---
  Allow to choose if the ports configuration is statically defined.

config PORT_JSON_CONFIG_FILE
  string "Path to json file for Port configuration"
  default "/legato/systems/current/apps/portService/read-only/usr/local/share/PortConfigurationFile.json" if LINUX
  ---help---
  Do not modify the default value.

endmenu # end "Port Service"

menu "Modem Service"

config ENABLE_ECALL
  bool "Enable eCall support"
  default y
  ---help---
  Enable PAN European eCall or Russian ERA GLONASS emergency calling support.

config MDM_HAS_SMSC_INFORMATION
  bool "Has SMSC information"
  default y
  ---help---
  Support SMSC (Short Message Service Centre) information in modem services.
  Some terminals do not include the SMSC information in the PDU format string
  and in those cases, this value must be deselected.

config SIM_ENABLE_AUTOSWITCH
  bool "Enable SIM auto switch support"
  depends on QMI
  default y if TARGET_WP76XX
  default y if TARGET_WP77XX
  default n
  ---help---
  Enable SIM auto switch support.

config MODEM_DAEMON_PREFERRED_NETWORK
  bool "Enable preferred network management API"
  default y if POSIX
  ---help---
    Allow managing preferred networks via Legato API.

config ENABLE_PCI_SCAN
  bool "Enable use of PCI scan related APIs"
  default y if LINUX
  default n
  ---help---
    Allow managing PCI scan information via Legato API.

config ENABLE_TIME_TO_OS
  bool "Enable provide time and date to OS"
  default y if LINUX
  default n
  ---help---
    Allow the modem service to provide time information to the OS.

config ENABLE_SIM_WAKEUP_FALLBACK
  bool "Enable SIM fallback options"
  default n
  ---help---
    Allow the setting of SIM fallback options for device wakeup/
    initialization.

config ENABLE_DEFAULT_APN_SWITCHING
  bool "Enable default apn switching"
  default y
  ---help---
    In the event that sim is roaming, the module will automatically
    switch to the default APN of the sim.

endmenu

menu "Secure Storage"

config ENABLE_SECSTORE_ADMIN
  bool "Enable secure storage administration API"
  default $(b2k,$(SECSTOREADMIN))
  ---help---
  Allow administrative control of the Legato secure storage system.  This
  permits reading, writing, and deleting secure storage files and should be
  used with caution.

config SECSTORE_IKS_BACKEND
  bool "Use IoT Keystore as SecStore encryption engine"
  default y
  ---help---
    Use IoT Keystore as SecStore back-end to encrypt/decrypt the user data.

endmenu # end "Secure Storage"

menu "Positioning Service"

config POSITIONING_ACTIVATION_MAX
  int "Define the maximum number of concurrent positioning activation requests"
  default 13

config ENABLE_GNSS_ACQUISITION_RATE_SETTING
  bool "Allow GNSS acquisition rate to be set via Legato API"
  default y

endmenu # end "Positioning Service"

menu "Data Connection Service"

config ENABLE_ETHERNET
  bool "Enable DCS to manage Ethernet"
  default n if RTOS
  default y
  ---help---
  Enable Legato Ethernet support.

endmenu # end "Data Connection Service"

config FEATURE_SPISVC
  bool "Enable SPI service"
  default y if TARGET_WP85
  default y if TARGET_WP750X
  default y if TARGET_WP76XX
  default y if TARGET_WP77XX
  default n
  ---help---
  Enable the SPI service to allow devices to use SPI-attached peripherals.

config SMS_SERVICE_ENABLED
  bool "Enable SMS Service"
  depends on POSIX
  default y
  ---help---
    Enable SMS Service, which is not supported on RTOS systems.

menu "MQTT Service"

config MQTT_CLIENT_BUFFER_SIZE_MAX_NUM
  int "Maximum size of buffers used for MQTT Client read and write operations"
  range 0 4096
  default 512
  ---help---
  The maximum size of MQTT Client read and write buffers.

config MQTT_CLIENT_SESSION_MAX_NUM
  int "Maximum number of MQTT Client sessions"
  range 0 4096
  default 5
  ---help---
  The maximum number of MQTT Client sessions.

endmenu # end "MQTT Service"
```

## components/KConfig
```kconfig
#
# Configuration for Legato component libraries.
#
# Copyright (C) Sierra Wireless Inc.
#

menu "FTP Client"

config SWIFTP
  bool "Using SIERRA FTP feature"
  default n
  ---help---
  this will enable Sierra FTP feature based on le_socketlib.

config FTPCLIENT_SESSION_MAX
  int "Maximum number simultaneous FTP client sessions"
  depends on LWIP || SWIFTP
  range 1 1024
  default 2
  ---help---
  Maximum number of simultaneous FTP client sessions permitted.  This value is
  used for sizing memory pools.

config FTPCLIENT_EVENT_MAX
  int "Size of FTP client asynchronous event queue"
  depends on LWIP
  range 1 1024
  default 8
  ---help---
  Maximum number of FTP client events that can be queued at once.

config FTPCLIENT_BUFFER_SIZE
  int "Size of FTP client data buffers"
  depends on LWIP
  range 8 65536
  default 256
  ---help---
  Size in bytes of the data buffers used to queue up chunks of data for
  sending or receiving.

config FTPCLIENT_SERVER_NAME_MAX
  int "Maximum size of server name"
  depends on LWIP || SWIFTP
  range 2 1024
  default 64
  ---help---
  Maximum size of FTP server name.  This size includes the terminating NUL
  character.

config FTPCLIENT_USER_NAME_MAX
  int "Maximum size of user name"
  depends on LWIP || SWIFTP
  range 2 1024
  default 32
  ---help---
  Maximum size of FTP user name.  This size includes the terminating NUL
  character.

config FTPCLIENT_PASSWORD_MAX
  int "Maximum size of user name"
  depends on LWIP || SWIFTP
  range 2 1024
  default 32
  ---help---
  Maximum size of FTP password.  This size includes the terminating NUL
  character.

endmenu # end "FTP Client"

menu "Socket Library"

config SOCKET_LIB_SESSION_MAX
  int "Maximum number of simultaneous sockets"
  range 1 1024
  default 2 if RTOS
  default 4
  ---help---
  Maximum number of simultaneous sockets. This value is used for sizing
  memory pools.

choice
  prompt "SSL Encryption Library"
  default SOCKET_LIB_USE_MBEDTLS if RTOS
  default SOCKET_LIB_USE_OPENSSL
  ---help---
  Select the SSL library implementation to use with the socket library.

config SOCKET_LIB_NO_SSL
  bool "None"
  ---help---
  Do not use an SSL encryption library

config SOCKET_LIB_USE_OPENSSL
  bool "OpenSSL"
  depends on !RTOS
  ---help---
  Use OpenSSL for SSL encryption in socket library.

config SOCKET_LIB_USE_MBEDTLS
  bool "mbedTLS"
  depends on EXPERIMENTAL
  ---help---
  Use mbedTLS for SSL encryption in socket library.

endchoice # end "SSL Encryption Library"

endmenu # end "Socket Library"
```
