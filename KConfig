## framework/daemons/KConfig
```kconfig
#
# Configuration for Legato core daemons.
#
# Copyright (C) Sierra Wireless Inc.
#

### Daemon Options ###

config WDOG_FRAMEWORK
  bool "Enable Legato watchdog on framework services"
  default y
  ---help---
  The watchdog observes the Legato framework daemons and, if one deadlocks,
  restarts the system.

config WDOG_HASHTABLE_SIZE
  int "Watchdog hashtable size"
  range 1 65535
  default 31
  ---help---
  The maximum number of watchdogs to be monitored

menu "Framework Daemon Log Level Settings"

choice
  prompt "Supervisor Log Level"
  optional
  ---help---
  Supervisor Log Level Settings, toggle back to default via SPACEBAR.

config SUPERVISOR_LOG_LEVEL_DEBUG
  bool "Debug"
  ---help---
  Include all statements up to and including debug level.

config SUPERVISOR_LOG_LEVEL_INFO
  bool "Info"
  ---help---
  Include all statements up to and including info level.

config SUPERVISOR_LOG_LEVEL_WARN
  bool "Warning"
  ---help---
  Include all statements up to and including warning level.

config SUPERVISOR_LOG_LEVEL_ERR
  bool "Error"
  ---help---
  Include all statements up to and including error level.

config SUPERVISOR_LOG_LEVEL_CRIT
  bool "Critical"
  ---help---
  Include all statements up to and including critical level.

config SUPERVISOR_LOG_LEVEL_EMERG
  bool "Emergency"
  ---help---
  Include only emergency-level log statements.
endchoice # end "Supervisor Log Level"

choice
  prompt "ServiceDirectory Log Level"
  optional
  ---help---
  ServiceDirectory Log Level Settings, toggle back to default via SPACEBAR.

config SERVICEDIRECTORY_LOG_LEVEL_DEBUG
  bool "Debug"
  ---help---
  Include all statements up to and including debug level.

config SERVICEDIRECTORY_LOG_LEVEL_INFO
  bool "Info"
  ---help---
  Include all statements up to and including info level.

config SERVICEDIRECTORY_LOG_LEVEL_WARN
  bool "Warning"
  ---help---
  Include all statements up to and including warning level.

config SERVICEDIRECTORY_LOG_LEVEL_ERR
  bool "Error"
  ---help---
  Include all statements up to and including error level.

config SERVICEDIRECTORY_LOG_LEVEL_CRIT
  bool "Critical"
  ---help---
  Include all statements up to and including critical level.

config SERVICEDIRECTORY_LOG_LEVEL_EMERG
  bool "Emergency"
  ---help---
  Include only emergency-level log statements.
endchoice # end "ServiceDirectory Log Level"

choice
  prompt "LogCtrlDaemon Log Level"
  optional
  ---help---
  LogCtrlDaemon Log Level Settings, toggle back to default via SPACEBAR.

config LOGCTRLDAEMON_LOG_LEVEL_DEBUG
  bool "Debug"
  ---help---
  Include all statements up to and including debug level.

config LOGCTRLDAEMON_LOG_LEVEL_INFO
  bool "Info"
  ---help---
  Include all statements up to and including info level.

config LOGCTRLDAEMON_LOG_LEVEL_WARN
  bool "Warning"
  ---help---
  Include all statements up to and including warning level.

config LOGCTRLDAEMON_LOG_LEVEL_ERR
  bool "Error"
  ---help---
  Include all statements up to and including error level.

config LOGCTRLDAEMON_LOG_LEVEL_CRIT
  bool "Critical"
  ---help---
  Include all statements up to and including critical level.

config LOGCTRLDAEMON_LOG_LEVEL_EMERG
  bool "Emergency"
  ---help---
  Include only emergency-level log statements.
endchoice # end "LogCtrlDaemon Log Level"

choice
  prompt "ConfigTree Log Level"
  optional
  ---help---
  ConfigTree Log Level Settings, toggle back to default via SPACEBAR.

config CONFIGTREE_LOG_LEVEL_DEBUG
  bool "Debug"
  ---help---
  Include all statements up to and including debug level.

config CONFIGTREE_LOG_LEVEL_INFO
  bool "Info"
  ---help---
  Include all statements up to and including info level.

config CONFIGTREE_LOG_LEVEL_WARN
  bool "Warning"
  ---help---
  Include all statements up to and including warning level.

config CONFIGTREE_LOG_LEVEL_ERR
  bool "Error"
  ---help---
  Include all statements up to and including error level.

config CONFIGTREE_LOG_LEVEL_CRIT
  bool "Critical"
  ---help---
  Include all statements up to and including critical level.

config CONFIGTREE_LOG_LEVEL_EMERG
  bool "Emergency"
  ---help---
  Include only emergency-level log statements.
endchoice # end "ConfigTree Log Level"

choice
  prompt "UpdateDaemon Log Level"
  optional
  ---help---
  UpdateDaemon Log Level Settings, toggle back to default via SPACEBAR.

config UPDATEDAEMON_LOG_LEVEL_DEBUG
  bool "Debug"
  ---help---
  Include all statements up to and including debug level.

config UPDATEDAEMON_LOG_LEVEL_INFO
  bool "Info"
  ---help---
  Include all statements up to and including info level.

config UPDATEDAEMON_LOG_LEVEL_WARN
  bool "Warning"
  ---help---
  Include all statements up to and including warning level.

config UPDATEDAEMON_LOG_LEVEL_ERR
  bool "Error"
  ---help---
  Include all statements up to and including error level.

config UPDATEDAEMON_LOG_LEVEL_CRIT
  bool "Critical"
  ---help---
  Include all statements up to and including critical level.

config UPDATEDAEMON_LOG_LEVEL_EMERG
  bool "Emergency"
  ---help---
  Include only emergency-level log statements.
endchoice # end "UpdateDaemon Log Level"

choice
  prompt "Watchdog Log Level"
  optional
  ---help---
  Watchdog Log Level Settings, toggle back to default via SPACEBAR.

config WATCHDOG_LOG_LEVEL_DEBUG
  bool "Debug"
  ---help---
  Include all statements up to and including debug level.

config WATCHDOG_LOG_LEVEL_INFO
  bool "Info"
  ---help---
  Include all statements up to and including info level.

config WATCHDOG_LOG_LEVEL_WARN
  bool "Warning"
  ---help---
  Include all statements up to and including warning level.

config WATCHDOG_LOG_LEVEL_ERR
  bool "Error"
  ---help---
  Include all statements up to and including error level.

config WATCHDOG_LOG_LEVEL_CRIT
  bool "Critical"
  ---help---
  Include all statements up to and including critical level.

config WATCHDOG_LOG_LEVEL_EMERG
  bool "Emergency"
  ---help---
  Include only emergency-level log statements.
endchoice # end "Watchdog Log Level"

endmenu # end "Framework Daemon Log Level Settings"

config SUPERVISOR_LOG_LEVEL
  string
  default "DEBUG" if SUPERVISOR_LOG_LEVEL_DEBUG
  default "INFO" if SUPERVISOR_LOG_LEVEL_INFO
  default "WARNING" if SUPERVISOR_LOG_LEVEL_WARN
  default "ERROR" if SUPERVISOR_LOG_LEVEL_ERR
  default "CRITICAL" if SUPERVISOR_LOG_LEVEL_CRIT
  default "EMERGENCY" if SUPERVISOR_LOG_LEVEL_EMERG
  default ""

config SERVICEDIRECTORY_LOG_LEVEL
  string
  default "DEBUG" if SERVICEDIRECTORY_LOG_LEVEL_DEBUG
  default "INFO" if SERVICEDIRECTORY_LOG_LEVEL_INFO
  default "WARNING" if SERVICEDIRECTORY_LOG_LEVEL_WARN
  default "ERROR" if SERVICEDIRECTORY_LOG_LEVEL_ERR
  default "CRITICAL" if SERVICEDIRECTORY_LOG_LEVEL_CRIT
  default "EMERGENCY" if SERVICEDIRECTORY_LOG_LEVEL_EMERG
  default ""

config LOGCTRLDAEMON_LOG_LEVEL
  string
  default "DEBUG" if LOGCTRLDAEMON_LOG_LEVEL_DEBUG
  default "INFO" if LOGCTRLDAEMON_LOG_LEVEL_INFO
  default "WARNING" if LOGCTRLDAEMON_LOG_LEVEL_WARN
  default "ERROR" if LOGCTRLDAEMON_LOG_LEVEL_ERR
  default "CRITICAL" if LOGCTRLDAEMON_LOG_LEVEL_CRIT
  default "EMERGENCY" if LOGCTRLDAEMON_LOG_LEVEL_EMERG
  default ""

config CONFIGTREE_LOG_LEVEL
  string
  default "DEBUG" if CONFIGTREE_LOG_LEVEL_DEBUG
  default "INFO" if CONFIGTREE_LOG_LEVEL_INFO
  default "WARNING" if CONFIGTREE_LOG_LEVEL_WARN
  default "ERROR" if CONFIGTREE_LOG_LEVEL_ERR
  default "CRITICAL" if CONFIGTREE_LOG_LEVEL_CRIT
  default "EMERGENCY" if CONFIGTREE_LOG_LEVEL_EMERG
  default ""

config UPDATEDAEMON_LOG_LEVEL
  string
  default "DEBUG" if UPDATEDAEMON_LOG_LEVEL_DEBUG
  default "INFO" if UPDATEDAEMON_LOG_LEVEL_INFO
  default "WARNING" if UPDATEDAEMON_LOG_LEVEL_WARN
  default "ERROR" if UPDATEDAEMON_LOG_LEVEL_ERR
  default "CRITICAL" if UPDATEDAEMON_LOG_LEVEL_CRIT
  default "EMERGENCY" if UPDATEDAEMON_LOG_LEVEL_EMERG
  default ""

config WATCHDOG_LOG_LEVEL
  string
  default "DEBUG" if WATCHDOG_LOG_LEVEL_DEBUG
  default "INFO" if WATCHDOG_LOG_LEVEL_INFO
  default "WARNING" if WATCHDOG_LOG_LEVEL_WARN
  default "ERROR" if WATCHDOG_LOG_LEVEL_ERR
  default "CRITICAL" if WATCHDOG_LOG_LEVEL_CRIT
  default "EMERGENCY" if WATCHDOG_LOG_LEVEL_EMERG
  default ""

rsource "linux/supervisor/KConfig"
rsource "linux/serviceDirectory/KConfig"
rsource "configTree/KConfig"
rsource "linux/watchdog/KConfig"
```

## framework/daemons/configTree/KConfig
```kconfig
#
# Configuration for Legato configTree daemon.
#
# Copyright (C) Sierra Wireless Inc.
#

### Options ###

config CFGTREE_MAX_USER_POOL_SIZE
  int "Maximum user pool size"
  depends on LINUX
  range 1 65535
  default 31
  ---help---
  The maximum number of user objects in the configTree user pool.

config CFGTREE_MAX_DSTRING_POOL_SIZE
  int "Maximum dynamic string pool size"
  range 1 65535
  default 3000
  default 30 if RTOS
  ---help---
  The maximum number of dynamic string objects in the configTree string pool.

config CFGTREE_MAX_ITERATOR_POOL_SIZE
  int "Maximum config iterator pool size"
  range 1 65535
  default 20
  ---help---
  The maximum number of iterator objects in the configTree iterator pool.

config CFGTREE_MAX_UPDATE_POOL_SIZE
  int "Maximum update pool size"
  range 1 65535
  default 3
  ---help---
  The maximum number of iterator objects in the configTree iterator pool.
  This determines the maximum number of concurrent configTree updates.

config CFGTREE_MAX_NODE_POOL_SIZE
  int "Maximum config node pool size"
  range 1 65535
  default 100
  ---help---
  The maximum number of node objects in the configTree node pool.

config CFGTREE_MAX_TREE_POOL_SIZE
  int "Maximum config tree pool size"
  range 1 65535
  default 31
  ---help---
  The maximum number of tree objects in the configTree tree pool.

config CFGTREE_MAX_HANDLER_POOL_SIZE
  int "Maximum node event handler pool size"
  range 1 65535
  default 31
  ---help---
  The maximum number of node event handler objects in the configTree handler
  pool.

config CFGTREE_MAX_BINARY_DATA_POOL_SIZE
  int "Maximum binary data buffer pool size"
  range 1 65535
  default 31
  ---help---
  The maximum number of binary data buffers in the configTree binary data
  buffer pool.

config CFGTREE_MAX_ENCODED_STRING_POOL_SIZE
  int "Maximum encoded string buffer pool size"
  range 1 65535
  default 31
  ---help---
  The maximum number of encoded string buffers in the configTree encoded
  string buffer pool.

config CFGTREE_MAX_TREE_ITERATOR_POOL_SIZE
  int "Maximum tree iterator pool size"
  range 1 65535
  default 11
  ---help---
  The maximum number of tree iterators in the configTree tree iterator pool.
```

## framework/daemons/linux/serviceDirectory/KConfig
```kconfig
#
# Configuration for Legato Service Directory daemon.
#
# Copyright (C) Sierra Wireless Inc.
#

### Options ###

menu "Service Directory"

config SVCDIR_SERVER_SOCKET_NAME
  string "Service directory server socket name"
  default "$(def,$(LE_SVCDIR_SERVER_SOCKET_NAME),serviceDirectoryServer)"
  ---help---
  Name of the Service Directory's server UNIX domain socket.  The full
  path will be this name appended to the runtime directory path.

config SVCDIR_CLIENT_SOCKET_NAME
  string "Service directory client socket name"
  default "$(def,$(LE_SVCDIR_CLIENT_SOCKET_NAME),serviceDirectoryClient)"
  ---help---
  Name of the Service Directory's client UNIX domain socket.  The full
  path will be this name appended to the runtime directory path.

endmenu # end "Service Directory"
```

## framework/daemons/linux/supervisor/KConfig
```kconfig
#
# Configuration for Legato full supervisor daemon.
#
# Copyright (C) Sierra Wireless Inc.
#

### Options ###

menu "Supervisor"

config SUPERV_NICE_LEVEL
  int "Nice level"
  depends on POSIX
  range -20 19
  default $(def,$(LEGATO_FRAMEWORK_NICE_LEVEL),-19)
  ---help---
  The nice level of the Legato Supervisor, which forks other Legato processes.

config SUPERV_APP_TMPFS_SIZE
  int "App tmpfs size"
  depends on LINUX
  default 90112
  ---help---
  The size in bytes of the tmpfs partition created for each sandboxed App.

endmenu # end "Supervisor"
```

## framework/daemons/linux/watchdog/KConfig
```kconfig
#
# Configuration for Legato watchdog daemon.
#
# Copyright (C) Sierra Wireless Inc.
#

### Options ###

menu "Watchdog Daemon"

config WDOG_ENABLE_EXTERNAL
  bool "Enable external watchdog"
  depends on LINUX
  default y if TARGET_WP750X || TARGET_WP85
  default n
  ---help---
  Kick an external hardware or software watchdog from the Legato watchdog
  daemon.

config WDOG_PA_MODULE
  string "Kernel module for external watchdog"
  depends on LINUX && WDOG_ENABLE_EXTERNAL
  default "softdog"
  ---help---
  Name of the kernel module to load in order to enable the external watchdog.

config WDOG_PA_DEVICE
  string "External watchdog device"
  depends on LINUX && WDOG_ENABLE_EXTERNAL
  default "/dev/watchdog"
  ---help---
  Name of the device to use to kick the external watchdog.

endmenu # end "Watchdog Daemon"
```

## modules/KConfig
```kconfig
#
# Configuration for Legato modules.
#
# Copyright (C) Sierra Wireless Inc.
#

### Sub-sections ###

orsource "WiFi/KConfig"
```
